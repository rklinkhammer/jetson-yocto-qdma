## meta-qdma/conf/distro/jetson-qdma.conf
```bitbake
DISTRO = "jetson-qdma"
DISTRO_NAME = "Jetson QDMA"
DISTRO_VERSION = "1.0"
DISTRO_FEATURES = "acl ipv4 ipv6 pci pam seccomp systemd usrmerge opengl x11 polkit wifi bluetooth alsa pulseaudio gobject-introspection-data"
INIT_MANAGER = "systemd"
PREFERRED_PROVIDER_virtual/kernel:tegra = "linux-noble-nvidia-tegra"
VIRTUAL-RUNTIME_graphical_init_manager = "lxdm"
PACKAGECONFIG:append:pn-networkmanager = " nmtui"
PACKAGECONFIG:append:pn-gvfs = " udisks2 archive fuse"
```

## meta-qdma/conf/layer.conf
```bitbake
BBPATH .= ":${LAYERDIR}"
BBFILES += "${LAYERDIR}/recipes-*/*/*.bb ${LAYERDIR}/recipes-*/*/*.bbappend"
BBFILE_COLLECTIONS += "qdma"
BBFILE_PATTERN_qdma = "^${LAYERDIR}/"
BBFILE_PRIORITY_qdma = "10"
LAYERSERIES_COMPAT_qdma = "wrynose"
LAYERDEPENDS_qdma = "core tegra"
```
